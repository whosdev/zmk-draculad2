## config/west.yml
```yaml
manifest:
  remotes:
    - name: zmkfirmware
      url-base: https://github.com/zmkfirmware
    - name: macros
      url-base: https://github.com/caksoylar
  projects:
    - name: zmk
      remote: macros
      revision: rebased-macros
      import: app/west.yml
  self:
    path: config
```
