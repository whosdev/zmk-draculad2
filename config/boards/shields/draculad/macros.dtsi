macro_qu: macro_qu {
    compatible = "zmk,behavior-macro";
    label = "MACRO_QU";
    #binding-cells = <0>;
    bindings = <&kp Q>, <&kp U>;
};

macro_pipe: macro_pipe {
    compatible = "zmk,behavior-macro";
    label = "MACRO_PIPE";
    #binding-cells = <0>;
    bindings = <&kp PIPE>, <&kp PIPE>;
};
